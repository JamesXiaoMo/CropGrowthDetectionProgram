//以下为库引用
#define DHT11PIN 23
#define BLINKER_WIFI
#define uS_TO_S_FACTOR 1000000ULL
#define TIME_TO_SLEEP  1800 
#include <Arduino.h>
#include <U8g2lib.h>
#include <Wire.h>
#include <WiFi.h>
#include <dht11.h>
#include <strings_en.h>
#include <WiFiManager.h>
#include <Blinker.h>
dht11 DHT11;
U8G2_SH1106_128X64_NONAME_F_SW_I2C u8g2(U8G2_R0, /* clock=*/ 0, /* data=*/ 5, /* reset=*/ U8X8_PIN_NONE);

//以下为定义常量
char devname[] = "农作物生长监测系统";   //定义WIFI名称和主机名
int DevID=1;
String DevCode="112233";
const char* host="192.168.0.7";
const int Port = 8080;
char Auth[]="ee03b9b248a8";
float humi_read = 0;
float temp_read = 0;
float illum_read =0;
float dirthum_read=0;
RTC_DATA_ATTR int bootCount = 0;
BlinkerNumber HUMI("humi");
BlinkerNumber TEMP("temp");
BlinkerNumber ILLUM("illum");
BlinkerNumber DIRTHUM("dirthum");
WiFiManager wifiManager;


//以下为字库
uint8_t font[][128] = 
{
  {0x00,0x00,0x00,0x00,0x00,0x00,0xF8,0x3F,0x08,0x20,0x08,0x20,0x0C,0x20,0x0C,0x20,
  0x0C,0x20,0x0C,0x20,0x08,0x20,0x08,0x20,0xF8,0x3F,0x00,0x00,0x00,0x00,0x00,0x00},/*"D:\Ardunio_Programs\CropGrowthDetectionProgram\Client\字模文件\电池没电.BMP",0*/
  {0x00,0x00,0x00,0x00,0x00,0x00,0xF8,0x3F,0x08,0x3C,0x08,0x3C,0x0C,0x3C,0x0C,0x3C,
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  0x00,0x00,0x0C,0x00,0x0C,0x00,0x00,0x00,0x0C,0x00,0x0C,0x00,0x00,0x00,0x00,0x00},/*"D:\Ardunio_Programs\CropGrowthDetectionProgram\Client\字模文件\：.BMP",14*/
};

//以下为函数
float Run_DHT11_Tem(){    //DHT11检测温度              
  int chk = DHT11.read(DHT11PIN);   //DHT11自检
  Serial.print("DHT11温湿度传感器状态: ");
  if (DHT11.temperature==0){
    Serial.println("DHT11温湿度传感器状态：传感器接触不良");  
  }else{  
    switch (chk)
      {
      case DHTLIB_OK: 
                  Serial.println("正常"); 
                  break;
      case DHTLIB_ERROR_CHECKSUM: 
                  Serial.println("传输验证发生错误"); 
                  break;
      case DHTLIB_ERROR_TIMEOUT: 
                  Serial.println("超时"); 
                  break;
      default: 
                  Serial.println("未知错误"); 
                  break;
    }
  }
  return DHT11.temperature;              
}

float Run_DHT11_Hum(){    //DHT11检测湿度
  return DHT11.humidity;
}

float Run_DIRTSENSOR(int DIRTSENSORPIN){    //土壤湿度传感器检测土壤湿度
  pinMode(DIRTSENSORPIN,INPUT);
  if (analogRead(DIRTSENSORPIN)==0){
    Serial.println("土壤湿度传感器状态:传感器接触不良");
  }else{
    Serial.println("土壤湿度传感器状态:正常");
  }
  return analogRead(DIRTSENSORPIN);
}

float Run_ILLUMINATIONSENSOR(int ILLUMINATIONSENSORPIN){    //光敏传感器检测光照强度
  pinMode(ILLUMINATIONSENSORPIN,INPUT);
  if (analogRead(ILLUMINATIONSENSORPIN)==0){
    Serial.println("光敏传感器状态:传感器接触不良");
  }else{
    Serial.println("光敏传感器状态:正常");
  }  
  return analogRead(ILLUMINATIONSENSORPIN);  
}

void WebConfig() {
  Serial.println("进入配网模式");
  wifiManager.setConfigPortalTimeout(60);  //设置连接超时时间60s
  wifiManager.autoConnect(devname);
  WiFi.hostname(devname);  //设置主机名
  Serial.println("");
    Serial.print("单片机已连接到WiFi: ");
    Serial.println(WiFi.SSID());              // WiFi名称
    Serial.print("IP地址:\t");
    Serial.println(WiFi.localIP());           // IP
}

void Screen_Display (int X,int Y,int width,int height,int font_ID){   //屏幕显示字库内容
  u8g2.setFont(u8g2_font_freedoomr10_tu);
  u8g2.setFontDirection(0);
  u8g2.setCursor(0, 15);  
  u8g2.drawXBM(X,Y,width,height,font[font_ID]);
  u8g2.sendBuffer();
}

void If_Sever_Connected (){   //连接并判断是否连接到服务器
  if (!client.connect(host,Port)) {
    Serial.println("服务器连接失败");
    return;
  }else{
    Serial.println("服务器连接成功");
    Screen_Display(112,16,16,16,6);
  }
}

void If_WiFi_Connected (){
  if (WiFi.status() == WL_CONNECTED){   //判断是否连接到WiFi并显示图标
    Screen_Display(96,0,16,16,4);
  }else{
    Screen_Display(96,0,16,16,5);
  }
}

void Desktop_Setup (){
  Screen_Display(0,0,16,16,7);
  Screen_Display(16,0,16,16,9);
  Screen_Display(32,0,16,16,14);
  Screen_Display(76,4,12,12,12);
  
  Screen_Display(0,16,16,16,8);
  Screen_Display(16,16,16,16,9);
  Screen_Display(32,16,16,16,14);
  Screen_Display(76,20,6,12,13);

  Screen_Display(0,32,32,16,10);
  Screen_Display(32,32,16,16,8);
  Screen_Display(48,32,16,16,9);
  Screen_Display(64,32,16,16,14);
  Screen_Display(108,36,6,12,13);

  Screen_Display(0,48,64,16,11);
  Screen_Display(64,48,16,16,14);
  Screen_Display(108,52,6,12,13);
}

void heartbeat()
{
    HUMI.print(humi_read);
    TEMP.print(temp_read);
    ILLUM.print(illum_read);
    DIRTHUM.print(dirthum_read);
}

void dataStorage()
{
    Blinker.dataStorage("temp", temp_read);
    Blinker.dataStorage("humi", humi_read);
    Blinker.dataStorage("illum", illum_read);
    Blinker.dataStorage("dirthum", dirthum_read);
}

//以下为主程序
void setup() {                                                   
  Serial.begin(9600);
  WiFiClient client;
  Blinker.begin(Auth, WiFi.SSID().c_str(), WiFi.psk().c_str()); 
  BLINKER_DEBUG.stream(Serial);
  BLINKER_DEBUG.debugAll();
  Blinker.attachHeartbeat(heartbeat);
  Blinker.attachDataStorage(dataStorage);
  //wifiManager.resetSettings();
  u8g2.begin();
  u8g2.enableUTF8Print();
  Screen_Display(112,0,16,16,0);
  WebConfig();
  Desktop_Setup();
  esp_sleep_enable_timer_wakeup(TIME_TO_SLEEP * uS_TO_S_FACTOR);
}

void loop() {
  Blinker.run();
  If_WiFi_Connected();
  If_Sever_Connected();
  float tem=Run_DHT11_Tem();
  float hum=Run_DHT11_Hum();
  float dirthum=Run_DIRTSENSOR(33);
  float Dirthum=100-(dirthum/3300*100);
  float illumination=Run_ILLUMINATIONSENSOR(32);
  float Illumination=illumination/5000*100;
  temp_read=tem;
  humi_read=hum;
  illum_read=Illumination;
  dirthum_read=Dirthum;
  u8g2.setCursor(40,16);
  u8g2.print(tem);
  u8g2.setCursor(40,32);
  u8g2.print(hum);
  u8g2.setCursor(72,48);
  u8g2.print(Dirthum);
  u8g2.setCursor(72,64);
  u8g2.print(Illumination);
  String Temp ="<<<" + String(DevID) + "," + DevCode + "," + String(tem,2) + "," + String(hum,2) + "," + String(dirthum,2) + "," + String(illumination,2) + ">>>";
  client.print(Temp);
  Serial.print("温度:");                       
  Serial.print(tem);
  Serial.println("℃");                                    
  Serial.print("湿度:");
  Serial.print(hum);                                    
  Serial.println("%");
  Serial.print("土壤湿度:");
  Serial.println(dirthum);
  Serial.print("光照强度:");
  Serial.println(illumination);  
  if (0<dirthum && dirthum <=300){
    Serial.println("土壤情况干燥");
  }else if(300<dirthum && dirthum<=700){
    Serial.println("土壤情况湿润");  
  }else if(700<dirthum && dirthum<=950){
    Serial.println("土壤情况过度湿润");
  }
  Serial.println("===========================");
  //u8g2.clearBuffer();
  delay(10000);
  //esp_deep_sleep_start();                                          
}
